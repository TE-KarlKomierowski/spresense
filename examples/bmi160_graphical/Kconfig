## examples/bmi160_graphical/Kconfig
```kconfig
#
# For a description of the syntax of this configuration file,
# see the file kconfig-language.txt in the NuttX tools repository.
#

config EXAMPLES_BMI160_GRAPHICAL
	bool "Bosch BMI160 graphical demo"
	default n
	depends on BMI160
	select CXD56_SPI
	select CXD56_SPI4
	select LCD_ILI9340
	select LCD_ILI9340_IFACE0

	---help---
		Enable the 6 axis sensor example

if EXAMPLES_BMI160_GRAPHICAL

config EXAMPLES_BMI160_GRAPHICAL_PROGNAME
	string "Program name"
	default "BMI160_GRAPHICAL"
	depends on BUILD_KERNEL
	---help---
		This is the name of the program that will be use when the NSH ELF
		program is installed.

config EXAMPLES_BMI160_GRAPHICAL_PRIORITY
	int "BMI160 graphical demo task priority"
	default 100

config EXAMPLES_BMI160_GRAPHICAL_STACKSIZE
	int "BMI160 graphical demo stack size"
	default 2048

endif
```

## examples/bmi160_rotating/Kconfig
```kconfig
#
# For a description of the syntax of this configuration file,
# see the file kconfig-language.txt in the NuttX tools repository.
#

config EXAMPLES_BMI160_ROTATING
	bool "Bosch BMI160 rotating demo"
	default n
	depends on BMI160
	select CXD56_SPI
	select CXD56_SPI4
	select LCD
	select LCD_ILI9340
	select LCD_ILI9340_IFACE0
	select CXD56_I2C
	select CXD56_I2C0
	---help---
		Enable the Bosch BMI160 rotating demo

if EXAMPLES_BMI160_ROTATING

config EXAMPLES_BMI160_ROTATING_PROGNAME
	string "Program name"
	default "bmi160_rotating"
	depends on BUILD_KERNEL
	---help---
		This is the name of the program that will be use when the NSH ELF
		program is installed.

config EXAMPLES_BMI160_ROTATING_PRIORITY
	int "BMI160 rotating task priority"
	default 100

config EXAMPLES_BMI160_ROTATING_STACKSIZE
	int "BMI160 rotating stack size"
	default 2048

endif
```

## sdk/configs/examples/bmi160_graphical-defconfig
```kconfig
CONFIG_SDK_USER_ENTRYPOINT="bmi160_graphical"
CONFIG_CXD56_I2C0=y
CXD56_I2C0_SCUSEQ=n
CONFIG_SENSORS=y
CONFIG_BMI160=y
CONFIG_BMI160_I2C=y
CONFIG_BMI160_SCU=n
CONFIG_LCD=y
CONFIG_LCD_ILI9340=y
CONFIG_LCD_ILI9340_IFACE0=y
CONFIG_LCD_ON_MAIN_BOARD=y
CONFIG_LCD_ON_EXTENSION_BOARD=n
CONFIG_CXD56_DMAC_SPI5_TX=y
CONFIG_CXD56_I2C=y
CONFIG_CXD56_I2C2=y
CONFIG_CXD56_CISIF=y
CONFIG_VIDEO=y
CONFIG_VIDEO_ISX012=y
CONFIG_CXD56_SDIO=y
CONFIG_EXAMPLES_BMI160_GRAPHICAL=y
CONFIG_IMAGEPROC=y
```

## sdk/configs/examples/bmi160_rotating-defconfig
```kconfig
CONFIG_SDK_USER_ENTRYPOINT="bmi160_rotating"
CONFIG_CXD56_I2C0=y
CXD56_I2C0_SCUSEQ=n
CONFIG_SENSORS=y
CONFIG_BMI160=y
CONFIG_BMI160_I2C=y
CONFIG_BMI160_SCU=n
CONFIG_LCD=y
CONFIG_LCD_ILI9340=y
CONFIG_LCD_ILI9340_IFACE0=y
CONFIG_LCD_ON_MAIN_BOARD=y
CONFIG_LCD_ON_EXTENSION_BOARD=n
CONFIG_CXD56_DMAC_SPI5_TX=y
CONFIG_CXD56_I2C=y
CONFIG_CXD56_I2C2=y
CONFIG_CXD56_CISIF=y
CONFIG_CXD56_SDIO=y
CONFIG_EXAMPLES_BMI160_ROTATING=y
CONFIG_IMAGEPROC=y
```
